## firmware/main/Kconfig.projbuild
```kconfig
menu "Yahamic"

    config YAHAMIC_SELFTEST
        bool "开机自检:采集 1 秒并打印响度"
        default n
        help
            台架调试用:开机采集 1 秒,在日志里打印 RMS 与削波情况,
            不连 Mac 也能确认麦克风链路是好的。

    choice YAHAMIC_SPECTRUM_STYLE
        prompt "讲话时的屏幕动效"
        default YAHAMIC_SPECTRUM_BARS
        help
            电平条:24 根居中对称的圆角条随声音起伏,下方 mm:ss 计时
            (与 Mac 端讲话浮层同款);
            正弦声波:三条流动的包络曲线随音量起伏,音高(频谱重心)
            连续驱动流速与疏密。

        config YAHAMIC_SPECTRUM_BARS
            bool "电平条 + 计时"
        config YAHAMIC_SPECTRUM_WAVES
            bool "正弦声波(流动曲线)"
    endchoice

endmenu
```
